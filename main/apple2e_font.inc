/*
 * Apple IIe built-in font data (7x8 pixels, 96 printable ASCII characters)
 * Characters $20 (space) through $7F (DEL)
 * Each row is 7 bits wide (bit 6 = leftmost pixel)
 * Used for text mode rendering to GPU framebuffer
 */

#define APPLE2E_FONT_DATA

static const uint8_t apple2e_font[96 * 8] = {
    // $20 Space
    0x00, 0x00, 0x00, 0x00, 0x00, 0x00, 0x00, 0x00,
    // $21 !
    0x08, 0x08, 0x08, 0x08, 0x08, 0x00, 0x08, 0x00,
    // $22 "
    0x14, 0x14, 0x14, 0x00, 0x00, 0x00, 0x00, 0x00,
    // $23 #
    0x14, 0x14, 0x3E, 0x14, 0x3E, 0x14, 0x14, 0x00,
    // $24 $
    0x08, 0x3C, 0x0A, 0x1C, 0x28, 0x1E, 0x08, 0x00,
    // $25 %
    0x06, 0x26, 0x10, 0x08, 0x04, 0x32, 0x30, 0x00,
    // $26 &
    0x04, 0x0A, 0x0A, 0x04, 0x2A, 0x12, 0x2C, 0x00,
    // $27 '
    0x08, 0x08, 0x04, 0x00, 0x00, 0x00, 0x00, 0x00,
    // $28 (
    0x10, 0x08, 0x04, 0x04, 0x04, 0x08, 0x10, 0x00,
    // $29 )
    0x04, 0x08, 0x10, 0x10, 0x10, 0x08, 0x04, 0x00,
    // $2A *
    0x00, 0x08, 0x2A, 0x1C, 0x2A, 0x08, 0x00, 0x00,
    // $2B +
    0x00, 0x08, 0x08, 0x3E, 0x08, 0x08, 0x00, 0x00,
    // $2C ,
    0x00, 0x00, 0x00, 0x00, 0x00, 0x08, 0x08, 0x04,
    // $2D -
    0x00, 0x00, 0x00, 0x3E, 0x00, 0x00, 0x00, 0x00,
    // $2E .
    0x00, 0x00, 0x00, 0x00, 0x00, 0x00, 0x08, 0x00,
    // $2F /
    0x00, 0x20, 0x10, 0x08, 0x04, 0x02, 0x00, 0x00,
    // $30 0
    0x1C, 0x22, 0x32, 0x2A, 0x26, 0x22, 0x1C, 0x00,
    // $31 1
    0x08, 0x0C, 0x08, 0x08, 0x08, 0x08, 0x1C, 0x00,
    // $32 2
    0x1C, 0x22, 0x20, 0x18, 0x04, 0x02, 0x3E, 0x00,
    // $33 3
    0x3E, 0x20, 0x10, 0x18, 0x20, 0x22, 0x1C, 0x00,
    // $34 4
    0x10, 0x18, 0x14, 0x12, 0x3E, 0x10, 0x10, 0x00,
    // $35 5
    0x3E, 0x02, 0x1E, 0x20, 0x20, 0x22, 0x1C, 0x00,
    // $36 6
    0x38, 0x04, 0x02, 0x1E, 0x22, 0x22, 0x1C, 0x00,
    // $37 7
    0x3E, 0x20, 0x10, 0x08, 0x04, 0x04, 0x04, 0x00,
    // $38 8
    0x1C, 0x22, 0x22, 0x1C, 0x22, 0x22, 0x1C, 0x00,
    // $39 9
    0x1C, 0x22, 0x22, 0x3C, 0x20, 0x10, 0x0E, 0x00,
    // $3A :
    0x00, 0x00, 0x08, 0x00, 0x00, 0x08, 0x00, 0x00,
    // $3B ;
    0x00, 0x00, 0x08, 0x00, 0x00, 0x08, 0x08, 0x04,
    // $3C <
    0x10, 0x08, 0x04, 0x02, 0x04, 0x08, 0x10, 0x00,
    // $3D =
    0x00, 0x00, 0x3E, 0x00, 0x3E, 0x00, 0x00, 0x00,
    // $3E >
    0x04, 0x08, 0x10, 0x20, 0x10, 0x08, 0x04, 0x00,
    // $3F ?
    0x1C, 0x22, 0x20, 0x10, 0x08, 0x00, 0x08, 0x00,
    // $40 @
    0x1C, 0x22, 0x2A, 0x3A, 0x1A, 0x02, 0x3C, 0x00,
    // $41 A
    0x08, 0x14, 0x22, 0x22, 0x3E, 0x22, 0x22, 0x00,
    // $42 B
    0x1E, 0x22, 0x22, 0x1E, 0x22, 0x22, 0x1E, 0x00,
    // $43 C
    0x1C, 0x22, 0x02, 0x02, 0x02, 0x22, 0x1C, 0x00,
    // $44 D
    0x0E, 0x12, 0x22, 0x22, 0x22, 0x12, 0x0E, 0x00,
    // $45 E
    0x3E, 0x02, 0x02, 0x1E, 0x02, 0x02, 0x3E, 0x00,
    // $46 F
    0x3E, 0x02, 0x02, 0x1E, 0x02, 0x02, 0x02, 0x00,
    // $47 G
    0x3C, 0x02, 0x02, 0x32, 0x22, 0x22, 0x3C, 0x00,
    // $48 H
    0x22, 0x22, 0x22, 0x3E, 0x22, 0x22, 0x22, 0x00,
    // $49 I
    0x1C, 0x08, 0x08, 0x08, 0x08, 0x08, 0x1C, 0x00,
    // $4A J
    0x38, 0x10, 0x10, 0x10, 0x10, 0x12, 0x0C, 0x00,
    // $4B K
    0x22, 0x12, 0x0A, 0x06, 0x0A, 0x12, 0x22, 0x00,
    // $4C L
    0x02, 0x02, 0x02, 0x02, 0x02, 0x02, 0x3E, 0x00,
    // $4D M
    0x22, 0x36, 0x2A, 0x2A, 0x22, 0x22, 0x22, 0x00,
    // $4E N
    0x22, 0x26, 0x2A, 0x32, 0x22, 0x22, 0x22, 0x00,
    // $4F O
    0x1C, 0x22, 0x22, 0x22, 0x22, 0x22, 0x1C, 0x00,
    // $50 P
    0x1E, 0x22, 0x22, 0x1E, 0x02, 0x02, 0x02, 0x00,
    // $51 Q
    0x1C, 0x22, 0x22, 0x22, 0x2A, 0x12, 0x2C, 0x00,
    // $52 R
    0x1E, 0x22, 0x22, 0x1E, 0x0A, 0x12, 0x22, 0x00,
    // $53 S
    0x1C, 0x22, 0x02, 0x1C, 0x20, 0x22, 0x1C, 0x00,
    // $54 T
    0x3E, 0x08, 0x08, 0x08, 0x08, 0x08, 0x08, 0x00,
    // $55 U
    0x22, 0x22, 0x22, 0x22, 0x22, 0x22, 0x1C, 0x00,
    // $56 V
    0x22, 0x22, 0x22, 0x22, 0x14, 0x14, 0x08, 0x00,
    // $57 W
    0x22, 0x22, 0x22, 0x2A, 0x2A, 0x36, 0x22, 0x00,
    // $58 X
    0x22, 0x22, 0x14, 0x08, 0x14, 0x22, 0x22, 0x00,
    // $59 Y
    0x22, 0x22, 0x14, 0x08, 0x08, 0x08, 0x08, 0x00,
    // $5A Z
    0x3E, 0x20, 0x10, 0x08, 0x04, 0x02, 0x3E, 0x00,
    // $5B [
    0x1C, 0x04, 0x04, 0x04, 0x04, 0x04, 0x1C, 0x00,
    // $5C backslash
    0x00, 0x02, 0x04, 0x08, 0x10, 0x20, 0x00, 0x00,
    // $5D ]
    0x1C, 0x10, 0x10, 0x10, 0x10, 0x10, 0x1C, 0x00,
    // $5E ^
    0x08, 0x14, 0x22, 0x00, 0x00, 0x00, 0x00, 0x00,
    // $5F _
    0x00, 0x00, 0x00, 0x00, 0x00, 0x00, 0x3E, 0x00,
    // $60 `
    0x04, 0x08, 0x10, 0x00, 0x00, 0x00, 0x00, 0x00,
    // $61 a
    0x00, 0x00, 0x1C, 0x20, 0x3C, 0x22, 0x3C, 0x00,
    // $62 b
    0x02, 0x02, 0x1E, 0x22, 0x22, 0x22, 0x1E, 0x00,
    // $63 c
    0x00, 0x00, 0x3C, 0x02, 0x02, 0x02, 0x3C, 0x00,
    // $64 d
    0x20, 0x20, 0x3C, 0x22, 0x22, 0x22, 0x3C, 0x00,
    // $65 e
    0x00, 0x00, 0x1C, 0x22, 0x3E, 0x02, 0x1C, 0x00,
    // $66 f
    0x18, 0x24, 0x04, 0x0E, 0x04, 0x04, 0x04, 0x00,
    // $67 g
    0x00, 0x00, 0x3C, 0x22, 0x3C, 0x20, 0x1C, 0x00,
    // $68 h
    0x02, 0x02, 0x1A, 0x26, 0x22, 0x22, 0x22, 0x00,
    // $69 i
    0x08, 0x00, 0x0C, 0x08, 0x08, 0x08, 0x1C, 0x00,
    // $6A j
    0x10, 0x00, 0x18, 0x10, 0x10, 0x12, 0x0C, 0x00,
    // $6B k
    0x02, 0x02, 0x12, 0x0A, 0x06, 0x0A, 0x12, 0x00,
    // $6C l
    0x0C, 0x08, 0x08, 0x08, 0x08, 0x08, 0x1C, 0x00,
    // $6D m
    0x00, 0x00, 0x16, 0x2A, 0x2A, 0x2A, 0x22, 0x00,
    // $6E n
    0x00, 0x00, 0x1A, 0x26, 0x22, 0x22, 0x22, 0x00,
    // $6F o
    0x00, 0x00, 0x1C, 0x22, 0x22, 0x22, 0x1C, 0x00,
    // $70 p
    0x00, 0x00, 0x1E, 0x22, 0x1E, 0x02, 0x02, 0x00,
    // $71 q
    0x00, 0x00, 0x3C, 0x22, 0x3C, 0x20, 0x20, 0x00,
    // $72 r
    0x00, 0x00, 0x1A, 0x26, 0x02, 0x02, 0x02, 0x00,
    // $73 s
    0x00, 0x00, 0x3C, 0x02, 0x1C, 0x20, 0x1E, 0x00,
    // $74 t
    0x04, 0x04, 0x0E, 0x04, 0x04, 0x24, 0x18, 0x00,
    // $75 u
    0x00, 0x00, 0x22, 0x22, 0x22, 0x32, 0x2C, 0x00,
    // $76 v
    0x00, 0x00, 0x22, 0x22, 0x22, 0x14, 0x08, 0x00,
    // $77 w
    0x00, 0x00, 0x22, 0x22, 0x2A, 0x2A, 0x14, 0x00,
    // $78 x
    0x00, 0x00, 0x22, 0x14, 0x08, 0x14, 0x22, 0x00,
    // $79 y
    0x00, 0x00, 0x22, 0x22, 0x3C, 0x20, 0x1C, 0x00,
    // $7A z
    0x00, 0x00, 0x3E, 0x10, 0x08, 0x04, 0x3E, 0x00,
    // $7B {
    0x30, 0x08, 0x08, 0x04, 0x08, 0x08, 0x30, 0x00,
    // $7C |
    0x08, 0x08, 0x08, 0x00, 0x08, 0x08, 0x08, 0x00,
    // $7D }
    0x06, 0x08, 0x08, 0x10, 0x08, 0x08, 0x06, 0x00,
    // $7E ~
    0x00, 0x04, 0x2A, 0x10, 0x00, 0x00, 0x00, 0x00,
    // $7F DEL (shown as checkerboard)
    0x2A, 0x14, 0x2A, 0x14, 0x2A, 0x14, 0x2A, 0x00,
};
