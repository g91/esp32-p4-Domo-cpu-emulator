## sdkconfig.defaults
```kconfig
# ESP32-P4 68000 Emulator Configuration
CONFIG_IDF_TARGET="esp32p4"

# Flash settings
CONFIG_ESPTOOLPY_FLASHMODE_QIO=y
CONFIG_ESPTOOLPY_FLASHSIZE_16MB=y

# Custom partition table (4MB app for tiny386 emulator)
CONFIG_PARTITION_TABLE_CUSTOM=y
CONFIG_PARTITION_TABLE_CUSTOM_FILENAME="partitions.csv"
CONFIG_PARTITION_TABLE_FILENAME="partitions.csv"

# SPIRAM/PSRAM - REQUIRED for 16MB RAM
CONFIG_SPIRAM=y
CONFIG_SPIRAM_SPEED_200M=y
CONFIG_SPIRAM_MODE_OCT=y

# Cache settings for better performance with PSRAM
CONFIG_CACHE_L2_CACHE_256KB=y
CONFIG_CACHE_L2_CACHE_LINE_128B=y

# Main task stack (increased for emulator + LCD)
CONFIG_ESP_MAIN_TASK_STACK_SIZE=16384

# FreeRTOS tick rate
CONFIG_FREERTOS_HZ=1000

# Console/UART settings
CONFIG_ESP_CONSOLE_UART_DEFAULT=y
CONFIG_ESP_CONSOLE_UART_BAUDRATE=115200

# Disable watchdog during long emulation runs
CONFIG_ESP_TASK_WDT_EN=n

# FAT filesystem for SD card
CONFIG_FATFS_VFS_FSTAT_BLKSIZE=4096
CONFIG_FATFS_LFN_HEAP=y
CONFIG_FATFS_MAX_LFN=255

# SPI LCD settings
CONFIG_LCD_ENABLE_DEBUG_LOG=n
```
